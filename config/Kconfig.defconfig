## config/Kconfig.defconfig
```kconfig
config ZMK_SPLIT
	default y

config I2C
	default y
      
config ZMK_POINTING
	default y
```

## config/west.yml
```yaml
manifest:
  remotes:
    - name: zmkfirmware
      url-base: https://github.com/zmkfirmware
    - name: AYM1607
      url-base: https://github.com/AYM1607
    - name: jayandoh
      url-base: https://github.com/jayandoh
  projects:
    - name: zmk
      remote: zmkfirmware
      revision: main
      import: app/west.yml
    - name: zmk-driver-azoteq-iqs5xx
      remote: jayandoh
      revision: main
  self:
    path: config
```
