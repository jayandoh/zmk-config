## config/boards/shields/shifty/Kconfig.defconfig
```kconfig
# Copyright (c) 2023 Jay Oh
# SPDX-License-Identifier: MIT

if SHIELD_SHIFTY

config ZMK_KEYBOARD_NAME
    default "shifty"

config SPI
	default y

endif 
```

## config/boards/shields/shifty/Kconfig.shield
```kconfig
# Copyright (c) 2023 Jay Oh
# SPDX-License-Identifier: MIT

config  SHIELD_SHIFTY
   def_bool $(shields_list_contains,shifty)
```
